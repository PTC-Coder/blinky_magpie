## boards/arm/nrf52832_magpie_blank/Kconfig.board
```kconfig
# Copyright (c) 2024 Nordic Semiconductor ASA
# SPDX-License-Identifier: Apache-2.0

config BOARD_NRF52832_MAGPIE_BLANK
	bool "nrf52832_magpie_blank"
	depends on SOC_NRF52832_CIAA
```
